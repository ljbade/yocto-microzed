## build/conf/bblayers.conf
```bitbake
# LAYER_CONF_VERSION is increased each time build/conf/bblayers.conf
# changes incompatibly
LCONF_VERSION = "6"

BBPATH = "${TOPDIR}"
BBFILES ?= ""

BBLAYERS ?= " \
  /home/travis/build/ljbade/yocto-microzed/poky/meta \
  /home/travis/build/ljbade/yocto-microzed/poky/meta-yocto \
  /home/travis/build/ljbade/yocto-microzed/poky/meta-yocto-bsp \
  /home/travis/build/ljbade/yocto-microzed/meta-xilinx \
  "
BBLAYERS_NON_REMOVABLE ?= " \
  /home/travis/build/ljbade/yocto-microzed/poky/meta \
  /home/travis/build/ljbade/yocto-microzed/poky/meta-yocto \
  "
```
